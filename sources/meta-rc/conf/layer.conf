## sources/meta-rc/conf/layer.conf
```bitbake
# We have a conf and classes directory, add to BBPATH
BBPATH .= ":${LAYERDIR}"

# We have recipes-* directories, add to BBFILES
BBFILES += "${LAYERDIR}/recipes-*/*/*.bb \
            ${LAYERDIR}/recipes-*/*/*.bbappend"

BBFILE_COLLECTIONS += "../sources/meta-rc"
BBFILE_PATTERN_../sources/meta-rc = "^${LAYERDIR}/"
BBFILE_PRIORITY_../sources/meta-rc = "6"

LAYERSERIES_COMPAT_../sources/meta-rc = "mickledore"
```
